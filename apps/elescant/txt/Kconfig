## apps/elescant/txt/Kconfig
```kconfig
#
# For a description of the syntax of this configuration file,
# see the file kconfig-language.txt in the NuttX tools repository.
#

config ELESCANT_TXT
	bool "OLED TXT"
	default n
	---help---
		Enable support for oled to display txt.
```
